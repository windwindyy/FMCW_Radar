/**
  SSD1306 128x64 I2C OLED 驱动 (软件I2C)
  PB13=SCL, PB15=SDA
*/
#include "stm32f411xe.h"
#include "oled.h"

#define OLED_ADDR   0x3C

#define SCL_PORT    GPIOB
#define SCL_PIN     (1U << 13)
#define SDA_PORT    GPIOB
#define SDA_PIN     (1U << 15)

#define SCL_H()     (SCL_PORT->BSRR = SCL_PIN)
#define SCL_L()     (SCL_PORT->BSRR = (SCL_PIN << 16))
#define SDA_H()     (SDA_PORT->BSRR = SDA_PIN)
#define SDA_L()     (SDA_PORT->BSRR = (SDA_PIN << 16))
#define SDA_RD()    ((SDA_PORT->IDR & SDA_PIN) != 0)

static uint8_t oled_buffer[OLED_WIDTH * OLED_HEIGHT / 8];

static void i2c_delay(void)
{
    for (volatile int i = 0; i < 40; i++) __NOP();
}

static void I2C_Start(void)
{
    SDA_H(); i2c_delay();
    SCL_H(); i2c_delay();
    SDA_L(); i2c_delay();
    SCL_L(); i2c_delay();
}

static void I2C_Stop(void)
{
    SDA_L(); i2c_delay();
    SCL_H(); i2c_delay();
    SDA_H(); i2c_delay();
}

static uint8_t I2C_WriteByte(uint8_t data)
{
    for (int i = 7; i >= 0; i--) {
        if (data & (1U << i))
            SDA_H();
        else
            SDA_L();
        i2c_delay();
        SCL_H(); i2c_delay();
        SCL_L(); i2c_delay();
    }
    // ACK
    SDA_H(); i2c_delay();
    SCL_H(); i2c_delay();
    uint8_t ack = SDA_RD() ? 0 : 1;
    SCL_L(); i2c_delay();
    return ack;
}

static void OLED_WriteCmd(uint8_t cmd)
{
    I2C_Start();
    I2C_WriteByte(OLED_ADDR << 1);
    I2C_WriteByte(0x00);     // control: command
    I2C_WriteByte(cmd);
    I2C_Stop();
}

static void OLED_WriteData(const uint8_t *data, uint16_t len)
{
    I2C_Start();
    I2C_WriteByte(OLED_ADDR << 1);
    I2C_WriteByte(0x40);     // control: data
    for (uint16_t i = 0; i < len; i++)
        I2C_WriteByte(data[i]);
    I2C_Stop();
}

// 6x8 ASCII font (ASCII 32-126), column-major
static const uint8_t font6x8[95][6] = {
    {0x00,0x00,0x00,0x00,0x00,0x00}, // space
    {0x00,0x00,0x5F,0x00,0x00,0x00}, // !
    {0x00,0x07,0x00,0x07,0x00,0x00}, // "
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    {0x08,0x04,0x08,0x10,0x08,0x00}, // ~
};

void OLED_Init(void)
{
    // PB13(SCL) / PB15(SDA): open-drain output
    RCC->AHB1ENR |= RCC_AHB1ENR_GPIOBEN;

    GPIOB->MODER   &= ~((3U << 26) | (3U << 30));
    GPIOB->MODER   |=  ((1U << 26) | (1U << 30));  // output
    GPIOB->OTYPER  |=  (SCL_PIN | SDA_PIN);         // open-drain
    GPIOB->OSPEEDR |=  ((3U << 26) | (3U << 30));   // high speed
    GPIOB->PUPDR   &= ~((3U << 26) | (3U << 30));
    GPIOB->PUPDR   |=  ((1U << 26) | (1U << 30));   // pull-up

    SCL_H(); SDA_H();

    // SSD1306 init sequence
    OLED_WriteCmd(0xAE);  // display off
    OLED_WriteCmd(0xD5); OLED_WriteCmd(0x80);
    OLED_WriteCmd(0xA8); OLED_WriteCmd(0x3F);
    OLED_WriteCmd(0xD3); OLED_WriteCmd(0x00);
    OLED_WriteCmd(0x40);
    OLED_WriteCmd(0x8D); OLED_WriteCmd(0x14);
    OLED_WriteCmd(0x20); OLED_WriteCmd(0x00);
    OLED_WriteCmd(0xA1);
    OLED_WriteCmd(0xC8);
    OLED_WriteCmd(0xDA); OLED_WriteCmd(0x12);
    OLED_WriteCmd(0x81); OLED_WriteCmd(0xCF);
    OLED_WriteCmd(0xD9); OLED_WriteCmd(0xF1);
    OLED_WriteCmd(0xDB); OLED_WriteCmd(0x40);
    OLED_WriteCmd(0xA4);
    OLED_WriteCmd(0xA6);
    OLED_WriteCmd(0xAF);  // display on

    OLED_Clear();
    OLED_Update();
}

void OLED_Clear(void)
{
    for (int i = 0; i < sizeof(oled_buffer); i++)
        oled_buffer[i] = 0x00;
}

void OLED_Update(void)
{
    for (uint8_t page = 0; page < OLED_PAGES; page++) {
        OLED_WriteCmd(0xB0 + page);
        OLED_WriteCmd(0x00);
        OLED_WriteCmd(0x10);
        OLED_WriteData(&oled_buffer[page * OLED_WIDTH], OLED_WIDTH);
    }
}

void OLED_ShowString(uint8_t x, uint8_t y, const char *str)
{
    while (*str) {
        if (x > 20) { x = 0; y++; }
        if (y > 7) break;

        uint8_t idx = (*str >= 32 && *str <= 126) ? (*str - 32) : 0;
        uint8_t *buf = &oled_buffer[y * OLED_WIDTH + x * 6];
        for (int col = 0; col < 6; col++)
            buf[col] = font6x8[idx][col];

        x++; str++;
    }
}

void OLED_ShowNum(uint8_t x, uint8_t y, uint32_t num, uint8_t len)
{
    char buf[11];
    for (int i = len - 1; i >= 0; i--) {
        buf[i] = '0' + (num % 10);
        num /= 10;
    }
    buf[len] = '\0';
    OLED_ShowString(x, y, buf);
}
